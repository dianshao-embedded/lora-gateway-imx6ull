## meta/conf/distro/dianshao.conf
```bitbake
require conf/distro/include/fsl-base.inc

DISTRO = "dianshao"
DISTRO_NAME = "dianshao"
DISTRO_VERSION = "1.0.0"
DISTRO_FEATURES_append = " systemd"
DISTRO_FEATURES_remove = " wayland directfb x11"
VIRTUAL-RUNTIME_init_manager = "systemd"
```

## meta/conf/machine/loragateway.conf
```bitbake
# dianshao-my machine generate by dianshao
# Auto Generate by Dianshao
include conf/machine/imx6ullevk.conf
ACCEPT_FSL_EULA = "1"
UBOOT_SUFFIX = "imx"
UBOOT_MAKE_TARGET = "u-boot.imx"
UBOOT_CONFIG = "sd"
UBOOT_CONFIG[sd] = "mx6ull_gw1000_defconfig,sdcard"
KERNEL_DEVICETREE = "imx6ull-gw1000.dtb"
IMAGE_FSTYPES += "ext4"
```
